## arch/ksi/Kconfig.arm64
```kconfig
# SPDX-License-Identifier: GPL-2.0-only
#
# KSI arm64 sub-architecture configuration
#

config KSI_ARCH_ARM64
	def_bool y
	select ARM64
	select ARCH_KEEP_MEMBLOCK
	select ARCH_HAS_CURRENT_STACK_POINTER
	select ARCH_HAS_DEBUG_VIRTUAL
	select ARCH_HAS_FORTIFY_SOURCE
	select ARCH_HAS_GCOV_PROFILE_ALL
	select ARCH_HAS_KEEPINITRD
	select ARCH_HAS_PTE_SPECIAL
	select ARCH_HAS_SET_MEMORY
	select ARCH_HAS_STRICT_KERNEL_RWX
	select ARCH_HAS_STRICT_MODULE_RWX
	select ARCH_HAS_SYSCALL_WRAPPER
	select ARCH_HAS_TICK_BROADCAST if GENERIC_CLOCKEVENTS_BROADCAST
	select ARCH_STACKWALK
	select ARCH_USE_CMPXCHG_LOCKREF
	select ARCH_USE_QUEUED_RWLOCKS
	select ARCH_USE_QUEUED_SPINLOCKS
	select ARCH_USE_SYM_ANNOTATIONS
	select ARCH_WANT_DEFAULT_TOPDOWN_MMAP_LAYOUT
	select ARCH_WANT_FRAME_POINTERS
	select ARCH_WANT_LD_ORPHAN_WARN
	select BUILDTIME_TABLE_SORT
	select CLONE_BACKWARDS
	select COMMON_CLK
	select DCACHE_WORD_ACCESS
	select FRAME_POINTER
	select GENERIC_CLOCKEVENTS
	select GENERIC_CLOCKEVENTS_BROADCAST
	select GENERIC_CPU_AUTOPROBE
	select GENERIC_CPU_DEVICES
	select GENERIC_EARLY_IOREMAP
	select GENERIC_IDLE_POLL_SETUP
	select GENERIC_IOREMAP
	select GENERIC_IRQ_SHOW
	select GENERIC_IRQ_SHOW_LEVEL
	select GENERIC_IRQ_PROBE
	select GENERIC_SCHED_CLOCK
	select GENERIC_SMP_IDLE_THREAD
	select GENERIC_TIME_VSYSCALL
	select GENERIC_GETTIMEOFDAY
	select HARDIRQS_SW_RESEND
	select HAVE_ARCH_AUDITSYSCALL
	select HAVE_ARCH_JUMP_LABEL
	select HAVE_ARCH_JUMP_LABEL_RELATIVE
	select HAVE_ARCH_SECCOMP_FILTER
	select HAVE_ARCH_TRACEHOOK
	select HAVE_ARCH_TRANSPARENT_HUGEPAGE
	select HAVE_ASM_MODVERSIONS
	select HAVE_DEBUG_KMEMLEAK
	select HAVE_DMA_CONTIGUOUS
	select HAVE_EFFICIENT_UNALIGNED_ACCESS
	select HAVE_FUNCTION_TRACER
	select HAVE_FUNCTION_GRAPH_TRACER
	select HAVE_GCC_PLUGINS
	select HAVE_GENERIC_VDSO
	select HAVE_PERF_EVENTS
	select HAVE_REGS_AND_STACK_ACCESS_API
	select HAVE_RSEQ
	select HAVE_STACKPROTECTOR
	select HAVE_SYSCALL_TRACEPOINTS
	select IRQ_DOMAIN
	select IRQ_FORCED_THREADING
	select LOCK_MM_AND_FIND_VMA
	select MODULES_USE_ELF_RELA
	select NEED_DMA_MAP_STATE
	select NO_IOPORT_MAP
	select OF
	select OF_EARLY_FLATTREE
	select SPARSE_IRQ
	select SYSCTL_EXCEPTION_TRACE
	select THREAD_INFO_IN_TASK
	select TRACE_IRQFLAGS_SUPPORT

# Source the full arm64 Kconfig to get all config symbols that arm64 code
# depends on (VA_BITS, PA_BITS, PAGE_SHIFT, PGTABLE_LEVELS, etc.).
source "arch/arm64/Kconfig"
```

## arch/ksi/configs/ksi_defconfig
```kconfig
CONFIG_EXPERT=y
CONFIG_PRINTK=y
CONFIG_BLK_DEV_INITRD=y
CONFIG_ARM64_4K_PAGES=y
CONFIG_ARM64_VA_BITS_48=y
# CONFIG_PCI is not set
# CONFIG_ACPI is not set
# CONFIG_KVM is not set
# CONFIG_VIRTUALIZATION is not set
# CONFIG_ARM_AMBA is not set
# CONFIG_ARM_ARCH_TIMER is not set
# CONFIG_ARM_GIC is not set
# CONFIG_ARM_GIC_V3 is not set
# CONFIG_ARM_GIC_V5 is not set
# CONFIG_ARM_PSCI_FW is not set
# CONFIG_EFI is not set
# CONFIG_HIBERNATION is not set
# CONFIG_KEXEC is not set
# CONFIG_XEN is not set
# CONFIG_SUSPEND is not set
# CONFIG_STACKPROTECTOR is not set
# CONFIG_JUMP_LABEL is not set
# CONFIG_UNMAP_KERNEL_AT_EL0 is not set
# CONFIG_MITIGATE_SPECTRE_BRANCH_HISTORY is not set
# CONFIG_RANDOMIZE_BASE is not set
# CONFIG_RELOCATABLE is not set
# CONFIG_ARM64_CONTPTE is not set
```

## kvisor/Kconfig
```kconfig
# SPDX-License-Identifier: GPL-2.0

menuconfig KVISOR
	bool "kVisor kernel-based sandbox"
	depends on RUST
	depends on X86_64
	help
	  kVisor is a kernel-based sandbox for running untrusted code.
	  It provides a Linux-compatible syscall interface implemented
	  in Rust, running directly in the kernel for maximum performance.

	  Sandboxed processes see a standard Linux environment, but all
	  syscalls are mediated by kVisor's Rust implementation.

	  This is similar to gVisor but:
	  - Written in Rust (for memory safety)
	  - Implemented directly in the kernel (for performance)
	  - No VM overhead or syscall interception overhead

	  If unsure, say N.

if KVISOR

config KVISOR_DEBUG
	bool "kVisor debugging support"
	help
	  Enable additional debugging output and assertions in kVisor.
	  This adds overhead and should only be enabled for development.

	  If unsure, say N.

config KVISOR_MEMFS
	bool "kVisor in-memory filesystem"
	default y
	help
	  Enable the in-memory filesystem for sandboxed processes.
	  This provides a tmpfs-like filesystem isolated from the host.

	  If unsure, say Y.

endif # KVISOR
```
